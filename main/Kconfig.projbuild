## main/Kconfig.projbuild
```kconfig
menu "NES ESP32-S3 - Pantalla 480x480 (ST7701 RGB)"

config LCD_MIRROR_X
    bool "Espejo horizontal (SDIR)"
    default y
config LCD_MIRROR_Y
    bool "Espejo vertical (MADCTL ML)"
    default y

endmenu

menu "NES ESP32-S3 - Tactil (GT911)"

config TOUCH_SDA
    int "GPIO SDA"
    default 19
config TOUCH_SCL
    int "GPIO SCL"
    default 45

endmenu

menu "NES ESP32-S3 - Zapper"

config ZAPPER_ENABLE
    bool "Zapper tactil activo por defecto si no se conoce el juego"
    default y

endmenu

menu "NES ESP32-S3 - Audio"

choice AUDIO_OUT
    prompt "Salida de audio"
    default AUDIO_I2S
config AUDIO_NONE
    bool "Sin sonido"
config AUDIO_I2S
    bool "I2S (bocina NS4168 de la placa, o DAC externo en H1)"
endchoice

config I2S_BCK
    int "GPIO BCK"
    depends on AUDIO_I2S
    default 1
config I2S_LRCK
    int "GPIO LRCK (WS)"
    depends on AUDIO_I2S
    default 2
config I2S_DIN
    int "GPIO DIN"
    depends on AUDIO_I2S
    default 40
config AUDIO_VOLUME
    int "Volumen (%)"
    depends on AUDIO_I2S
    range 0 400
    default 100

endmenu

menu "NES ESP32-S3 - Tarjeta SD (ROMs)"

config SD_ENABLE
    bool "Leer ROMs de la microSD al arrancar"
    default y
config SD_CLK
    int "GPIO CLK (verificado con la placa)"
    depends on SD_ENABLE
    default 48
config SD_CMD
    int "GPIO CMD (verificado con la placa)"
    depends on SD_ENABLE
    default 47
config SD_D0
    int "GPIO D0 (sin verificar)"
    depends on SD_ENABLE
    default 41
config SD_MHZ
    int "Velocidad (MHz)"
    depends on SD_ENABLE
    default 20

endmenu
```

## sdkconfig.defaults
```kconfig
CONFIG_IDF_TARGET="esp32s3"
CONFIG_ESPTOOLPY_FLASHSIZE_16MB=y
CONFIG_ESPTOOLPY_FLASHFREQ_80M=y
CONFIG_PARTITION_TABLE_CUSTOM=y
CONFIG_PARTITION_TABLE_CUSTOM_FILENAME="partitions.csv"
CONFIG_PARTITION_TABLE_FILENAME="partitions.csv"
CONFIG_ESP_DEFAULT_CPU_FREQ_MHZ_240=y
CONFIG_SPIRAM=y
CONFIG_SPIRAM_MODE_OCT=y
CONFIG_SPIRAM_SPEED_80M=y
CONFIG_FREERTOS_HZ=1000
CONFIG_FREERTOS_TIMER_TASK_STACK_DEPTH=4096
CONFIG_ESP_MAIN_TASK_STACK_SIZE=16384
CONFIG_COMPILER_OPTIMIZATION_PERF=y
CONFIG_ESP_TASK_WDT_EN=n
CONFIG_ESP_INT_WDT=n
CONFIG_BOOTLOADER_LOG_LEVEL_WARN=y
CONFIG_FATFS_LFN_HEAP=y
CONFIG_FATFS_MAX_LFN=255
CONFIG_FATFS_CODEPAGE_850=y
CONFIG_ESP32S3_DATA_CACHE_64KB=y
CONFIG_ESP32S3_DATA_CACHE_LINE_64B=y
CONFIG_AUDIO_I2S=y
CONFIG_I2S_BCK=1
CONFIG_I2S_LRCK=2
CONFIG_I2S_DIN=40
```
